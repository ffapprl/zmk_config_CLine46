## boards/shields/CLine46/Kconfig.shield
```kconfig
config SHIELD_CLINE46_R
    def_bool $(shields_list_contains,CLine46_R)

config SHIELD_CLINE46_L
    def_bool $(shields_list_contains,CLine46_L)
```

## config/west.yml
```yaml
manifest:
  remotes:
    - name: cormoran
      url-base: https://github.com/cormoran
    - name: badjeff    # <-- PMW3610
      url-base: https://github.com/badjeff
    - name: caksoylar  # <-- RGB LED
      url-base: https://github.com/caksoylar
  projects:
    # ZMK: DYA Studio 用カスタム RPC サブシステム付き cormoran fork
    - name: zmk
      remote: cormoran
      revision: v0.3-branch+dya
      import: app/west.yml

    # DYA Studio モジュール（すべて cormoran リポジトリ）
    - name: zmk-module-ble-management
      remote: cormoran
      revision: main
    - name: zmk-module-battery-history
      remote: cormoran
      revision: main
    - name: zmk-module-settings-rpc
      remote: cormoran
      revision: main
    - name: zmk-module-runtime-input-processor
      remote: cormoran
      revision: main
    - name: zmk-pmw3610-driver
      remote: badjeff
      revision: zmk-0.3
    - name: zmk-rgbled-widget
      remote: caksoylar
      revision: v0.3-branch
  self:
    path: config
```
